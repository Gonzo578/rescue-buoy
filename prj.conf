## CMakeLists.txt
```
# SPDX-License-Identifier: Apache-2.0

cmake_minimum_required(VERSION 3.20.0)

find_package(Zephyr REQUIRED HINTS $ENV{ZEPHYR_BASE})
project(rescue_buoy)

target_sources(app PRIVATE src/main.c)
```

## west.yml
```
# SPDX-License-Identifier: Apache-2.0
#
# West manifest for the rescue-buoy project (T2 "star" topology):
# this repository IS the manifest repository, and all dependencies are
# fetched into deps/ which is backed by a named Docker volume.

manifest:
  remotes:
    - name: zephyrproject-rtos
      url-base: https://github.com/zephyrproject-rtos

  projects:
    - name: zephyr
      remote: zephyrproject-rtos
      revision: v4.4.0
      import:
        # path-prefix applies to zephyr itself AND to every imported project,
        # so all dependencies land under deps/ (the named Docker volume).
        path-prefix: deps
        # name-allowlist => ONLY these modules are cloned, which keeps the
        # workspace at a few hundred MB instead of the ~8 GB full checkout.
        # If a build fails on a missing module, add its name here and re-run
        # `west update`.
        name-allowlist:
          - hal_espressif   # ESP32-S3 SoC support, ESP_IDF_PATH, RF blobs
          - picolibc        # default C library module

  self:
    path: rescue-buoy
```

## prj.conf
```kconfig
# SPDX-License-Identifier: Apache-2.0

# Serial console. The board DTS already sets zephyr,console = &uart0 at
# 115200 baud, and uart0 (GPIO43/44) is wired to the CH343 USB-UART bridge,
# so the same USB cable carries both flashing and the console.
CONFIG_SERIAL=y
CONFIG_CONSOLE=y
CONFIG_UART_CONSOLE=y

# Logging. Immediate mode means log calls are rendered synchronously, so the
# startup banner cannot be lost. Switch to the default deferred mode once the
# application grows and logging gets on the hot path.
CONFIG_LOG=y
CONFIG_LOG_MODE_IMMEDIATE=y

# Blinking LED (see boards/esp32s3_devkitc_esp32s3_procpu.overlay).
CONFIG_GPIO=y
```

## boards/esp32s3_devkitc_esp32s3_procpu.overlay
```dts
/*
 * Copyright (c) 2026 Ralf Hochhausen
 *
 * SPDX-License-Identifier: Apache-2.0
 *
 * The upstream esp32s3_devkitc board only defines the i2c-0, watchdog0,
 * uart-0 and sw0 aliases - there is no "leds" node and no led0 alias, so
 * any GPIO-LED application fails to build without this overlay.
 *
 * The only onboard LED is an addressable WS2812 RGB LED on GPIO38 (board
 * revision v1.1 moved it to GPIO48), and Zephyr 4.4 has no RMT-based WS2812
 * driver. We therefore drive an external LED on a plain GPIO instead.
 *
 * Wiring:  GPIO2 --[ 330 ohm ]--|>|-- GND
 *                              LED
 */

#include <zephyr/dt-bindings/gpio/gpio.h>

/ {
	aliases {
		led0 = &led_ext;
	};

	leds {
		compatible = "gpio-leds";

		/*
		 * ESP32-S3 GPIO banks: pins 0..31 -> &gpio0,
		 *                      pins 32..48 -> &gpio1 (index = pin - 32).
		 *
		 * GPIO2 is free and broken out on the header. Do not use:
		 *   GPIO26-32  SPI flash
		 *   GPIO33-37  octal PSRAM (the "R8" in N16R8)
		 *   GPIO43/44  UART0 TX/RX -> console
		 *   GPIO19/20  native USB D-/D+
		 *   GPIO0/45/46  boot strapping pins
		 *   GPIO38 (v1.0) / GPIO48 (v1.1)  onboard WS2812 RGB LED
		 * Other safe choices: GPIO1, 4, 5, 6, 7, 15, 16, 17, 18, 21.
		 */
		led_ext: led_0 {
			gpios = <&gpio0 2 GPIO_ACTIVE_HIGH>;
			label = "External LED";
		};
	};
};
```

## src/main.c
```c
/*
 * Copyright (c) 2026 Ralf Hochhausen
 *
 * SPDX-License-Identifier: Apache-2.0
 *
 * Increment 1: prove out the toolchain, the dev container and the board by
 * logging "Hello World!" to the serial console and blinking an LED at 1 Hz.
 */

#include <errno.h>

#include <zephyr/kernel.h>
#include <zephyr/drivers/gpio.h>
#include <zephyr/logging/log.h>

LOG_MODULE_REGISTER(main, LOG_LEVEL_INF);

/* Half a period on, half a period off -> 1 Hz. */
#define BLINK_PERIOD_MS 500U

/* Resolved from the led0 alias, which the board overlay provides. */
static const struct gpio_dt_spec led = GPIO_DT_SPEC_GET(DT_ALIAS(led0), gpios);

int main(void)
{
	int ret;

	LOG_INF("Hello World! %s", CONFIG_BOARD_TARGET);

	if (!gpio_is_ready_dt(&led)) {
		LOG_ERR("LED device %s is not ready", led.port->name);
		return -ENODEV;
	}

	ret = gpio_pin_configure_dt(&led, GPIO_OUTPUT_INACTIVE);
	if (ret < 0) {
		LOG_ERR("Failed to configure LED pin (%d)", ret);
		return ret;
	}

	LOG_INF("Blinking LED on %s pin %u every %u ms",
		led.port->name, led.pin, BLINK_PERIOD_MS);

	while (1) {
		ret = gpio_pin_toggle_dt(&led);
		if (ret < 0) {
			LOG_ERR("Failed to toggle LED (%d)", ret);
			return ret;
		}

		k_msleep(BLINK_PERIOD_MS);
	}

	return 0;
}
```
